## CMakeLists.txt
```
#
# Copyright (c) 2021 Nordic Semiconductor ASA
#
# SPDX-License-Identifier: LicenseRef-Nordic-5-Clause
#

cmake_minimum_required(VERSION 3.20.0)

# Set Kconfig root files that will be processed as a first Kconfig for used child images.
set(mcuboot_KCONFIG_ROOT "\\\${ZEPHYR_CONNECTEDHOMEIP_MODULE_DIR}/config/nrfconnect/chip-module/Kconfig.mcuboot.root")
set(multiprotocol_rpmsg_KCONFIG_ROOT "\\\${ZEPHYR_CONNECTEDHOMEIP_MODULE_DIR}/config/nrfconnect/chip-module/Kconfig.multiprotocol_rpmsg.root")
set(hci_rpmsg_KCONFIG_ROOT "\\\${ZEPHYR_CONNECTEDHOMEIP_MODULE_DIR}/config/nrfconnect/chip-module/Kconfig.hci_rpmsg.root")

# For prj.conf the CONF_FILE is empty. In other case extract the exact file name from the path string.
if(CONF_FILE)
    get_filename_component(CONFIG_FILE_NAME ${CONF_FILE} NAME)
endif()

if("${CONFIG_FILE_NAME}" STREQUAL "prj_thread_wifi_switched.conf")
    set(PM_STATIC_YML_FILE ${CMAKE_CURRENT_SOURCE_DIR}/configuration/${BOARD}/pm_static_thread_wifi_switched.yml)
elseif(NOT "${CONFIG_FILE_NAME}" STREQUAL "prj_no_dfu.conf")
    set(PM_STATIC_YML_FILE ${CMAKE_CURRENT_SOURCE_DIR}/configuration/${BOARD}/pm_static_dfu.yml)
endif()

find_package(Zephyr HINTS $ENV{ZEPHYR_BASE})

project(lock_origin)

set(COMMON_ROOT ${ZEPHYR_NRF_MODULE_DIR}/samples/matter/common)
set(NLIO_ROOT ${ZEPHYR_CONNECTEDHOMEIP_MODULE_DIR}/third_party/nlio/repo)
include(${ZEPHYR_CONNECTEDHOMEIP_MODULE_DIR}/config/nrfconnect/app/enable-gnu-std.cmake)
include(${ZEPHYR_CONNECTEDHOMEIP_MODULE_DIR}/src/app/chip_data_model.cmake)

# NORDIC SDK APP START
target_include_directories(app PRIVATE
    src
    ${COMMON_ROOT}/src
    ${NLIO_ROOT}/include
    ${ZEPHYR_CONNECTEDHOMEIP_MODULE_DIR}/zzz_generated/app-common
)

target_sources(app PRIVATE
    src/app_task.cpp
    src/bolt_lock_manager.cpp
    src/main.cpp
    src/zcl_callbacks.cpp
    src/zap-generated/callback-stub.cpp
    src/zap-generated/IMClusterCommandHandler.cpp
    src/gdo_nus.cpp
    ${COMMON_ROOT}/src/led_widget.cpp
)

if(CONFIG_CHIP_OTA_REQUESTOR OR CONFIG_MCUMGR_TRANSPORT_BT)
    target_sources(app PRIVATE ${COMMON_ROOT}/src/ota_util.cpp)
endif()

if(CONFIG_CHIP_NUS)
    target_sources(app PRIVATE ${COMMON_ROOT}/src/bt_nus_service.cpp)
endif()

if(CONFIG_MCUMGR_TRANSPORT_BT)
    zephyr_library_link_libraries(MCUBOOT_BOOTUTIL)
    target_sources(app PRIVATE ${COMMON_ROOT}/src/dfu_over_smp.cpp)
endif()

if(CONFIG_THREAD_WIFI_SWITCHING)
    target_sources(app PRIVATE
        src/software_images_swapper.cpp
        ${COMMON_ROOT}/src/ota_multi_image_processor_impl.cpp
        ${COMMON_ROOT}/src/ota_multi_image_downloader.cpp
    )
endif()

if(CONFIG_CHIP_ICD_SUBSCRIPTION_HANDLING)
    target_sources(app PRIVATE ${COMMON_ROOT}/src/icd_util.cpp)
endif()

chip_configure_data_model(app
    INCLUDE_SERVER
    BYPASS_IDL
    GEN_DIR src/zap-generated
    ZAP_FILE ${CMAKE_CURRENT_SOURCE_DIR}/src/lock.zap
)

if(CONFIG_THREAD_WIFI_SWITCHING)
    find_package(Python3)
    set(app_idx ${CONFIG_APPLICATION_IDX})
    add_custom_target(flash-external
        COMMAND ${Python3_EXECUTABLE} ${CMAKE_CURRENT_SOURCE_DIR}/src/flash-external.py
            --app ${APPLICATION_BINARY_DIR}/zephyr/app_update.bin
            --app-offset ${PM_APP_${app_idx}_CORE_APP_OFFSET}
            --app-size ${PM_APP_${app_idx}_CORE_APP_SIZE}
            --net ${APPLICATION_BINARY_DIR}/zephyr/net_core_app_update.bin
            --net-offset ${PM_APP_${app_idx}_CORE_NET_OFFSET}
            --net-size ${PM_APP_${app_idx}_CORE_NET_SIZE}
        USES_TERMINAL
        DEPENDS
            ${APPLICATION_BINARY_DIR}/zephyr/app_update.bin
            ${APPLICATION_BINARY_DIR}/zephyr/net_core_app_update.bin
    )
endif()
# NORDIC SDK APP END
```

## prj.conf
```kconfig
#
# Copyright (c) 2022 Nordic Semiconductor ASA
#
# SPDX-License-Identifier: LicenseRef-Nordic-5-Clause
#

# This sample uses Kconfig.defaults to set options common for all
# samples. This file should contain only options specific for this sample
# or overrides of default values.

# Enable CHIP
CONFIG_CHIP=y
CONFIG_CHIP_PROJECT_CONFIG="src/chip_project_config.h"
# 32774 == 0x8006 (example lock-app)
CONFIG_CHIP_DEVICE_PRODUCT_ID=32774
CONFIG_STD_CPP14=y

# Add support for LEDs and buttons on Nordic development kits
CONFIG_DK_LIBRARY=y

# Bluetooth Low Energy configuration
CONFIG_BT_DEVICE_NAME="MatterLock"

# Suspend devices when the CPU goes into sleep
CONFIG_PM_DEVICE=y

# Other settings
CONFIG_THREAD_NAME=y
CONFIG_MPU_STACK_GUARD=y
CONFIG_RESET_ON_FATAL_ERROR=n
CONFIG_CHIP_LIB_SHELL=y

# Reduce application size
CONFIG_BT_DEBUG_LOG=y
CONFIG_BT_DEBUG_MONITOR_RTT=y
CONFIG_PRINTK=y
CONFIG_UART_CONSOLE=n
CONFIG_RTT_CONSOLE=y
CONFIG_LOG=y
CONFIG_LOG_BACKEND_RTT=y
CONFIG_LOG_PRINTK=y
CONFIG_CHIP_LIB_SHELL=y



CONFIG_MCUBOOT_IMGTOOL_SIGN_VERSION="1.0.0+0"
# Enable Factory Data feature
CONFIG_CHIP_FACTORY_DATA=y
CONFIG_CHIP_FACTORY_DATA_BUILD=y

CONFIG_CHIP_NUS=y

# Enable BLE fixed passkey
CONFIG_BT_FIXED_PASSKEY=y
CONFIG_CHIP_NUS_FIXED_PASSKEY=123456

CONFIG_CHIP_DEVICE_DISCRIMINATOR=0xD09
CONFIG_CHIP_DEVICE_SERIAL_NUMBER="123456789ABC009"
CONFIG_CHIP_DEVICE_SPAKE2_PASSCODE= 20201009
CONFIG_CHIP_DEVICE_VENDOR_NAME="ASSA ABLOY"
```

## src/gdo_nus.cpp
```c
/*
 * Copyright (c) 2023 Nordic Semiconductor ASA
 *
 * SPDX-License-Identifier: LicenseRef-Nordic-5-Clause
 */

#include "gdo_nus.h"

#include <zephyr/logging/log.h>
#include <zephyr/settings/settings.h>

#include <platform/CHIPDeviceLayer.h>

using namespace ::chip;
using namespace ::chip::DeviceLayer;

LOG_MODULE_DECLARE(app, CONFIG_MATTER_LOG_LEVEL);

#define NUS_BT_NAME (CONFIG_BT_DEVICE_NAME "_NUS")

namespace
{
constexpr uint32_t kAdvertisingOptions = BT_LE_ADV_OPT_CONNECTABLE;
constexpr uint8_t kAdvertisingFlags = BT_LE_AD_GENERAL | BT_LE_AD_NO_BREDR;
constexpr uint8_t kBTUuid[] = { BT_UUID_NUS_VAL };
} /* namespace */

BT_CONN_CB_DEFINE(conn_callbacks) = {
	.connected = GDONUSService::Connected,
	.disconnected = GDONUSService::Disconnected,
	.security_changed = GDONUSService::SecurityChanged,
};
bt_conn_auth_cb GDONUSService::sConnAuthCallbacks = {
	.passkey_display = AuthPasskeyDisplay,
	.cancel = AuthCancel,
};
bt_conn_auth_info_cb GDONUSService::sConnAuthInfoCallbacks = {
	.pairing_complete = PairingComplete,
	.pairing_failed = PairingFailed,
};
bt_nus_cb GDONUSService::sNusCallbacks = {
	.received = RxCallback,
};

GDONUSService GDONUSService::sInstance;
uint8_t door[3]={0x66,0x66, 0x00}; 
static volatile uint8_t test = 0x00; 
bool GDONUSService::Init(uint8_t priority, uint16_t minInterval, uint16_t maxInterval)
{
	mAdvertisingItems[0] = BT_DATA(BT_DATA_FLAGS, &kAdvertisingFlags, sizeof(kAdvertisingFlags));
	mAdvertisingItems[1] = BT_DATA(BT_DATA_NAME_COMPLETE, "TIEM", 4);
    mAdvertisingItems[2] = BT_DATA(BT_DATA_SVC_DATA16, door, sizeof(door));
	mServiceItems[0] = BT_DATA(BT_DATA_UUID128_ALL, kBTUuid, sizeof(kBTUuid));

	mAdvertisingRequest.priority = priority;
	mAdvertisingRequest.options = kAdvertisingOptions;
	mAdvertisingRequest.minInterval = minInterval;
	mAdvertisingRequest.maxInterval = maxInterval;
	mAdvertisingRequest.advertisingData = Span<bt_data>(mAdvertisingItems);
	mAdvertisingRequest.scanResponseData = Span<bt_data>(mServiceItems);

	mAdvertisingRequest.onStarted = [](int rc) {
		if (rc == 0) {
			GetGDONUSService().mIsStarted = true;
			LOG_DBG("NUS BLE advertising started");
		} else {
			LOG_ERR("Failed to start NUS BLE advertising: %d", rc);
		}
	};
	mAdvertisingRequest.onStopped = []() {
		GetGDONUSService().mIsStarted = false;
		LOG_DBG("NUS BLE advertising stopped");
	};
if (bt_conn_auth_cb_register(&sConnAuthCallbacks) != 0)
		return false;
	if (bt_conn_auth_info_cb_register(&sConnAuthInfoCallbacks) != 0)
		return false;
	if (bt_nus_init(&sNusCallbacks) != 0)
		return false;
#if defined(CONFIG_BT_FIXED_PASSKEY)
	if (bt_passkey_set(CONFIG_CHIP_NUS_FIXED_PASSKEY) != 0)
		return false;
#endif

	return true;
}

bool GDONUSService::StartServer()
{
	// if (mIsStarted) {
	// 	LOG_WRN("NUS service was already started");
	// 	return false;
	// }
    LOG_INF("Start NUS again");
    door[2] = test++; 
    mAdvertisingItems[2] = BT_DATA(BT_DATA_SVC_DATA16, door, sizeof(door));
	mAdvertisingRequest.advertisingData = Span<bt_data>(mAdvertisingItems);
	mAdvertisingRequest.scanResponseData = Span<bt_data>(mServiceItems);
	
    
	PlatformMgr().LockChipStack();
	CHIP_ERROR ret = BLEAdvertisingArbiter::InsertRequest(mAdvertisingRequest);
	PlatformMgr().UnlockChipStack();

	if (CHIP_NO_ERROR != ret) {
		LOG_ERR("Could not start NUS service");
		return false;
	}

	return true;
}

void GDONUSService::StopServer()
{
	if (!mIsStarted)
		return;

	PlatformMgr().LockChipStack();
	BLEAdvertisingArbiter::CancelRequest(mAdvertisingRequest);
	PlatformMgr().UnlockChipStack();
}

void GDONUSService::RxCallback(bt_conn *conn, const uint8_t *const data, uint16_t len)
{
	if (bt_conn_get_security(GetGDONUSService().mBTConnection) < BT_SECURITY_L2) {
		LOG_ERR("Received NUS command, but security requirements are not met.");
		return;
	}

	LOG_DBG("NUS received: %d bytes", len);
	GetGDONUSService().DispatchCommand(reinterpret_cast<const char *>(data), len);
}

bool GDONUSService::RegisterCommand(const char *const name, size_t length, CommandCallback callback, void *context)
{
	if (!name)
		return false;
	if (mCommandsCounter > CONFIG_CHIP_NUS_MAX_COMMANDS)
		return false;
	if (length > CONFIG_CHIP_NUS_MAX_COMMAND_LEN)
		return false;

	Command newCommand{};
	memcpy(newCommand.command, name, length);
	newCommand.callback = callback;
	newCommand.context = context;
	mCommandsList[mCommandsCounter++] = newCommand;

	return true;
}

void GDONUSService::DispatchCommand(const char *const data, uint16_t len)
{
	for (const auto &c : mCommandsList) {
		if (strncmp(data, c.command, len) == 0 && len == strlen(c.command)) {
			if (c.callback) {
				PlatformMgr().LockChipStack();
				c.callback(c.context);
				PlatformMgr().UnlockChipStack();
			}
			return;
		}
	}
	LOG_ERR("NUS command unknown!");
}

bool GDONUSService::SendData(const char *const data, size_t length)
{
	if (!mIsStarted || !mBTConnection)
		return false;
	if (bt_conn_get_security(mBTConnection) < BT_SECURITY_L2)
		return false;
	if (bt_nus_send(mBTConnection, reinterpret_cast<const uint8_t *const>(data), length) != 0)
		return false;

	return true;
}

void GDONUSService::Connected(bt_conn *conn, uint8_t err)
{
	if (GetGDONUSService().mIsStarted) {
		if (err || !conn) {
			LOG_ERR("NUS Connection failed (err %u)", err);
			return;
		}

		GetGDONUSService().mBTConnection = conn;
		bt_conn_set_security(conn, BT_SECURITY_L3);
	}
}

void GDONUSService::Disconnected(bt_conn *conn, uint8_t reason)
{
	GetGDONUSService().mBTConnection = nullptr;
}

void GDONUSService::SecurityChanged(bt_conn *conn, bt_security_t level, enum bt_security_err err)
{
	if (!GetGDONUSService().mIsStarted)
		return;

	if (!err) {
		LOG_DBG("NUS BT Security changed: %s level %u", LogAddress(conn), level);
	} else {
		LOG_ERR("NUS BT Security failed: level %u err %d", level, err);
	}
}

void GDONUSService::AuthPasskeyDisplay(bt_conn *conn, unsigned int passkey)
{
	LOG_INF("PROVIDE THE FOLLOWING CODE IN YOUR MOBILE APP: %d", passkey);
}

void GDONUSService::AuthCancel(bt_conn *conn)
{
	LOG_INF("NUS BT Pairing cancelled: %s", LogAddress(conn));

	bt_conn_disconnect(conn, BT_HCI_ERR_REMOTE_USER_TERM_CONN);
}

void GDONUSService::PairingComplete(bt_conn *conn, bool bonded)
{
	if (!GetGDONUSService().mIsStarted)
		return;

	LOG_DBG("NUS BT Pairing completed: %s, bonded: %d", LogAddress(conn), bonded);
}

void GDONUSService::PairingFailed(bt_conn *conn, enum bt_security_err reason)
{
	if (!GetGDONUSService().mIsStarted)
		return;

	LOG_ERR("NUS BT Pairing failed to %s : reason %d", LogAddress(conn), static_cast<uint8_t>(reason));
}

char *GDONUSService::LogAddress(bt_conn *conn)
{
#if CONFIG_LOG
	static char addr[BT_ADDR_LE_STR_LEN];
	bt_addr_le_to_str(bt_conn_get_dst(conn), addr, sizeof(addr));
	return addr;
#endif
	return NULL;
}
```

## src/gdo_nus.h
```c
/*
 * Copyright (c) 2023 Nordic Semiconductor ASA
 *
 * SPDX-License-Identifier: LicenseRef-Nordic-5-Clause
 */

#pragma once

#include "app_event.h"

#include <platform/Zephyr/BLEAdvertisingArbiter.h>

#include <bluetooth/services/nus.h>
#include <zephyr/bluetooth/bluetooth.h>
#include <zephyr/bluetooth/conn.h>

class GDONUSService {
public:
	using CommandCallback = void (*)(void *context);
	struct Command {
		char command[CONFIG_CHIP_NUS_MAX_COMMAND_LEN];
		CommandCallback callback;
		void *context;
	};

	/**
	 * @brief Initialize Nordic UART Service (NUS)
	 *
	 * Initialize internal structures and set Bluetooth LE advertisement parameters.
	 */
	bool Init(uint8_t priority, uint16_t minInterval, uint16_t maxInterval);

	/**
	 * @brief Start the Nordic UART Service server
	 *
	 * Register Nordic UART Service that supports controlling lock and unlock operations
	 * using Bluetooth LE commands. The Nordic UART Service may begin immediately.
	 */
	bool StartServer();

	/**
	 * @brief Stop the Nordic UART Service server
	 *
	 * Unregister Nordic UART Service  that supports controlling lock and unlock operations
	 * using Bluetooth LE commands. The Nordic UART Service will be disabled and the next service with the highest priority will begin immediately.
	 */
	void StopServer();

	/**
	 * @brief Send data to the connected device
	 * 
	 * Send data to the connected and paired device.
	 * 
	 * @return false if the device cannot send data, true otherwise.
	 */
	bool SendData(const char *const data, size_t length);

	/**
	 * @brief Register a new command for NUS service
	 * 
	 * The new command consist of a callback that will be called when the device receives the provided command name.
	 * The name of the command must be null-terminated.
	 * 
	 * @return false if there is no space for the next command (See CONFIG_CHIP_NUS_MAX_COMMANDS kConfig), or the name is empty.
	 */
	bool RegisterCommand(const char *const name, size_t length, CommandCallback callback, void *context);

	friend GDONUSService &GetLockGDONUSService();
	static GDONUSService sInstance;

	/**
	 * Static callbacks for the Bluetooth LE connection
	*/
	static void Connected(struct bt_conn *conn, uint8_t err);
	static void Disconnected(struct bt_conn *conn, uint8_t reason);
	static void SecurityChanged(struct bt_conn *conn, bt_security_t level, enum bt_security_err err);

private:

	void DispatchCommand(const char *const data, uint16_t len);

	static void RxCallback(struct bt_conn *conn, const uint8_t *const data, uint16_t len);
	static void AuthPasskeyDisplay(struct bt_conn *conn, unsigned int passkey);
	static void AuthCancel(struct bt_conn *conn);
	static void PairingComplete(struct bt_conn *conn, bool bonded);
	static void PairingFailed(struct bt_conn *conn, enum bt_security_err reason);
	static char* LogAddress(struct bt_conn *conn);

	static struct bt_conn_auth_cb sConnAuthCallbacks;
	static struct bt_conn_auth_info_cb sConnAuthInfoCallbacks;
	static struct bt_nus_cb sNusCallbacks;

	bool mIsStarted = false;
	chip::DeviceLayer::BLEAdvertisingArbiter::Request mAdvertisingRequest = {};
	std::array<bt_data, 3> mAdvertisingItems;
	std::array<bt_data, 1> mServiceItems;
	std::array<Command, CONFIG_CHIP_NUS_MAX_COMMANDS> mCommandsList;
	uint8_t mCommandsCounter = 0;
	struct bt_conn *mBTConnection;


};

inline GDONUSService &GetGDONUSService()
{
	return GDONUSService::sInstance;
}
```
